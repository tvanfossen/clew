## tests/data/kconfigsample/Kconfig
```kconfig
mainmenu "Widget firmware"

source "Kconfig.motor"

config WIDGET_LOG_LEVEL
	int "Log verbosity"
	default 2
	help
	  How chatty the widget is. Level 3 enables the packet dump, which is
	  far too slow for production and exists for bench debugging only.

menu "Radio"

config WIDGET_RADIO
	bool "Enable the radio"
	default y
	help
	  Bring the 2.4GHz radio up at boot.

endmenu
```

## tests/data/kconfigsample/Kconfig.motor
```kconfig
choice
	prompt "Motor variant"
	default WIDGET_MOTOR_ALPHA

config WIDGET_MOTOR_ALPHA
	bool "Alpha motor"
	help
	  Alpha motor. Valid supply range 18.0V-30.0V.

config WIDGET_MOTOR_BETA
	bool "Beta motor"
	help
	  Beta motor. Valid supply range 13.0V-21.0V.
	  Overcurrent thresholds are currently reused from the alpha motor as a
	  placeholder pending real measurements for this motor.

endchoice

config WIDGET_MOTOR_NAME
	string
	default "alpha" if WIDGET_MOTOR_ALPHA
	default "beta"
```
